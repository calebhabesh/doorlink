## main/Kconfig.projbuild
```kconfig
menu "Smart Doorbell application"

config SMART_DOORBELL_PRODUCTION_APP
    bool "Build the event-driven production application"
    default n
    help
        Enable the C++ wake/capture/upload/deep-sleep controller. Leave this
        disabled during hardware bring-up so the core-only safe image remains
        the default.

config SMART_DOORBELL_ENABLE_PIR_EVENTS
    bool "Enable PIR-triggered production events"
    depends on SMART_DOORBELL_PRODUCTION_APP
    default n
    help
        Arm GPIO3 as a production wake source and generate PIR_MOTION events.
        Leave this disabled for the normal button-only doorbell flow. The
        isolated wake diagnostic can still exercise PIR independently.

config SMART_DOORBELL_SPEAKER_ATTENUATION_DB
    int "Digital speaker attenuation (dB)"
    range 0 24
    default 6
    help
        Attenuate every production speaker stream before it reaches the
        MAX98357A. Six dB halves sample voltage, keeping the peak current of a
        4-ohm speaker near that of an 8-ohm speaker at the old setting.

config SMART_DOORBELL_SPEAKER_RAMP_MS
    int "Speaker fade-in/fade-out duration (ms)"
    range 0 250
    default 25
    help
        Apply a linear ramp at both ends of local chimes and homeowner replies
        to reduce clicks and abrupt current transients. Set to zero to disable.

config SMART_DOORBELL_CAMERA_OVERLAP_ACK
    bool "Allow a limited local acknowledgement during camera capture"
    depends on SMART_DOORBELL_PRODUCTION_APP
    default y
    help
        Permit represses from the camera-startup boundary through capture to
        play the normal chime waveform at a strongly attenuated level. The
        initial full-volume chime still drains before startup. Represses may
        restart the quiet waveform while the camera is active. This mode
        requires validation with the 4-ohm speaker and must never bypass the
        configured limits below.

config SMART_DOORBELL_CAMERA_OVERLAP_ACK_ATTENUATION_DB
    int "Camera-overlap chime attenuation (dB)"
    depends on SMART_DOORBELL_CAMERA_OVERLAP_ACK
    range 12 24
    default 18

config SMART_DOORBELL_CAMERA_OVERLAP_ACK_DURATION_MS
    int "Camera-overlap chime duration (ms)"
    depends on SMART_DOORBELL_CAMERA_OVERLAP_ACK
    range 250 4000
    default 3000
    help
        Use 3000 ms to retain the complete embedded doorbell waveform. The
        player clamps longer settings to the actual clip length. Short values
        crop the waveform and can sound unlike the normal doorbell.

config SMART_DOORBELL_REPRESS_HOLD_TO_TALK_MS
    int "Repress hold duration before visitor microphone handoff (ms)"
    depends on SMART_DOORBELL_PRODUCTION_APP
    range 500 3000
    default 1200
    help
        Require a deliberate hold before interrupting the local repress chime
        and handing the shared I2S bus to the visitor microphone. Shorter
        presses remain local acknowledgements and never start recording.

config SMART_DOORBELL_WAKE_SLEEP_DIAGNOSTIC
    bool "Build the button/PIR wake and deep-sleep diagnostic"
    default n
    help
        Build a bounded wake-only image. It never starts the camera, Wi-Fi,
        MQTT, amplifier, or I2S and returns to deep sleep after reporting the
        wake cause.

config SMART_DOORBELL_MIC_DIAGNOSTIC
    bool "Build the USB-powered MK1 microphone diagnostic"
    depends on !SMART_DOORBELL_PRODUCTION_APP && !SMART_DOORBELL_WAKE_SLEEP_DIAGNOSTIC
    default n
    help
        Build the isolated ICS-43434 I2S receive diagnostic. It keeps the
        camera, Wi-Fi, MQTT, speaker output, amplifier, and deep sleep
        disabled, then reports per-slot sample range and average magnitude.
        Use USB power only while investigating the Rev C battery-start fault.

endmenu
```
